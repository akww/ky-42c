/*
 * This software is contributed or developed by KYOCERA Corporation.
 * (C) 2020 KYOCERA Corporation
 *
 * This program is free software; you can redistribute it and/or modify
 * it under the terms of the GNU General Public License version 2 and
 * only version 2 as published by the Free Software Foundation.
 *
 * This program is distributed in the hope that it will be useful,
 * but WITHOUT ANY WARRANTY; without even the implied warranty of
 * MERCHANTABILITY or FITNESS FOR A PARTICULAR PURPOSE.  See the
 * GNU General Public License for more details.
 */

&odm {
	kc_battery {
		/* Fg_Temperature */
		kc_battery_temperature = 
		<
		(-30)	285639
		(-25)	205644
		(-20)	149635
		(-15)	110055
		(-10)	81768
		(-5)	61312
		0		46412
		5		35425
		10		27262
		15		21145
		20		16520
		25		13000
		30		10299
		35		8212
		40		6588
		45		5317
		50		4315
		55		3522
		60		2889
		65		2382
		70		1974
		>;
	};
};

&bat_gm30 {
	EMBEDDED_SEL = <(0)>;
};

&bat_gm30 {
	/* Battery Profile */
	battery0_profile_t0_num = <100>;
	battery0_profile_t0 =
	<
	158	41550	3038
	316	41420	2911
	474	41330	2911
	632	41230	2848
	790	41150	2848
	948	41060	2785
	1106	40990	2848
	1264	40920	2848
	1422	40840	2785
	1580	40770	2785
	1738	40690	2722
	1896	40610	2785
	2054	40530	2848
	2212	40450	2785
	2370	40370	2785
	2528	40290	2785
	2686	40210	2848
	2844	40140	2911
	3002	40060	2848
	3160	39980	2785
	3318	39910	2848
	3476	39840	2848
	3634	39760	2848
	3792	39690	2848
	3950	39630	2975
	4108	39550	2911
	4266	39480	2975
	4424	39410	3101
	4582	39330	3228
	4740	39230	3354
	4898	39110	3228
	5056	38980	2975
	5214	38890	2848
	5372	38800	2658
	5530	38740	2658
	5688	38690	2658
	5846	38630	2595
	6004	38580	2595
	6162	38530	2532
	6320	38480	2595
	6478	38440	2658
	6636	38390	2532
	6794	38350	2595
	6952	38310	2595
	7110	38270	2595
	7268	38230	2595
	7426	38190	2532
	7584	38150	2532
	7742	38110	2595
	7900	38080	2595
	8058	38040	2532
	8216	38010	2532
	8374	37980	2532
	8532	37950	2595
	8690	37920	2595
	8848	37890	2532
	9006	37860	2532
	9164	37830	2532
	9322	37810	2532
	9480	37790	2595
	9638	37760	2532
	9796	37750	2658
	9954	37720	2658
	10112	37690	2595
	10270	37660	2595
	10428	37600	2595
	10586	37540	2595
	10744	37490	2468
	10902	37470	2532
	11060	37440	2405
	11218	37410	2405
	11376	37390	2532
	11534	37350	2532
	11692	37320	2532
	11850	37280	2532
	12008	37240	2468
	12166	37220	2532
	12324	37190	2532
	12482	37140	2595
	12640	37100	2785
	12798	37030	2785
	12956	36950	2658
	13114	36900	2911
	13272	36810	2975
	13430	36710	2658
	13588	36660	2405
	13746	36650	2532
	13904	36630	2532
	14062	36610	2595
	14220	36590	2722
	14378	36560	2722
	14536	36530	2848
	14694	36480	2911
	14852	36420	3101
	15010	36340	3671
	15168	36180	4810
	15326	35850	5570
	15484	35410	6329
	15642	34870	7532
	15800	34180	9304
	>;
	battery0_profile_t1_num = <100>;
	battery0_profile_t1 =
	<
	166	42070	3675
	332	41930	3614
	498	41800	3614
	664	41680	3554
	830	41570	3614
	996	41460	3554
	1162	41360	3554
	1328	41260	3554
	1494	41160	3494
	1660	41070	3494
	1826	40980	3494
	1992	40900	3494
	2158	40810	3434
	2324	40740	3494
	2490	40670	3494
	2656	40590	3434
	2822	40520	3494
	2988	40450	3554
	3154	40360	3494
	3320	40290	3554
	3486	40210	3554
	3652	40130	3554
	3818	40050	3614
	3984	39970	3554
	4150	39900	3675
	4316	39820	3675
	4482	39740	3735
	4648	39670	3795
	4814	39580	3795
	4980	39500	3855
	5146	39420	4036
	5312	39320	4036
	5478	39210	3976
	5644	39080	3795
	5810	38970	3554
	5976	38860	3373
	6142	38790	3313
	6308	38710	3193
	6474	38660	3193
	6640	38600	3193
	6806	38540	3133
	6972	38490	3133
	7138	38440	3133
	7304	38390	3072
	7470	38350	3133
	7636	38300	3072
	7802	38260	3133
	7968	38220	3133
	8134	38170	3072
	8300	38140	3133
	8466	38100	3133
	8632	38050	3012
	8798	38020	3072
	8964	37990	3072
	9130	37960	3133
	9296	37920	3072
	9462	37890	3072
	9628	37860	3012
	9794	37850	3133
	9960	37810	3012
	10126	37790	3012
	10292	37770	3012
	10458	37750	3012
	10624	37720	2952
	10790	37700	2952
	10956	37680	2952
	11122	37670	3012
	11288	37650	3072
	11454	37630	3133
	11620	37600	3133
	11786	37580	3133
	11952	37550	3133
	12118	37530	3253
	12284	37500	3313
	12450	37450	3253
	12616	37410	3313
	12782	37380	3373
	12948	37330	3373
	13114	37290	3434
	13280	37240	3614
	13446	37180	3735
	13612	37100	3795
	13778	37020	3855
	13944	36940	4036
	14110	36830	4096
	14276	36720	3795
	14442	36660	3795
	14608	36620	3916
	14774	36580	4036
	14940	36540	4217
	15106	36500	4518
	15272	36450	4759
	15438	36390	5181
	15604	36320	5602
	15770	36220	6145
	15936	36060	6928
	16102	35760	8133
	16268	35280	9036
	16434	34650	10060
	16600	33870	11867
	>;
	battery0_profile_t2_num = <100>;
	battery0_profile_t2 =
	<
	142	40960	5282
	284	40840	5141
	426	40740	5070
	568	40650	5141
	710	40570	5070
	852	40480	5070
	994	40400	5141
	1136	40320	5141
	1278	40240	5141
	1420	40170	5211
	1562	40100	5282
	1704	40020	5282
	1846	39950	5282
	1988	39880	5352
	2130	39820	5423
	2272	39740	5352
	2414	39680	5493
	2556	39610	5493
	2698	39550	5634
	2840	39480	5704
	2982	39400	5775
	3124	39330	5915
	3266	39230	5775
	3408	39140	5775
	3550	39040	5704
	3692	38930	5563
	3834	38830	5282
	3976	38740	5141
	4118	38670	5070
	4260	38610	5000
	4402	38550	4930
	4544	38500	4930
	4686	38450	4930
	4828	38410	5000
	4970	38360	4930
	5112	38320	5000
	5254	38280	4930
	5396	38240	4930
	5538	38200	4859
	5680	38170	4930
	5822	38140	5000
	5964	38100	5000
	6106	38070	5000
	6248	38030	5000
	6390	38000	5000
	6532	37970	5000
	6674	37940	5000
	6816	37920	5000
	6958	37890	5070
	7100	37860	4930
	7242	37850	5070
	7384	37820	5000
	7526	37800	5000
	7668	37790	5070
	7810	37770	5070
	7952	37760	5070
	8094	37750	5282
	8236	37730	5282
	8378	37720	5423
	8520	37700	5563
	8662	37690	5704
	8804	37670	5775
	8946	37640	5845
	9088	37630	6056
	9230	37600	6127
	9372	37580	6268
	9514	37560	6408
	9656	37530	6549
	9798	37510	6690
	9940	37480	6831
	10082	37450	6901
	10224	37410	7042
	10366	37380	7254
	10508	37350	7465
	10650	37300	7606
	10792	37260	7817
	10934	37220	8099
	11076	37170	8380
	11218	37110	8592
	11360	37050	8944
	11502	36980	9296
	11644	36890	9577
	11786	36810	9930
	11928	36720	10352
	12070	36610	10634
	12212	36500	10775
	12354	36400	10775
	12496	36320	10986
	12638	36250	11197
	12780	36170	11338
	12922	36080	11408
	13064	35990	11549
	13206	35900	11690
	13348	35800	11831
	13490	35690	11972
	13632	35580	12183
	13774	35460	12535
	13916	35310	13169
	14058	35090	14014
	14200	34750	15000
	>;
	battery0_profile_t3_num = <100>;
	battery0_profile_t3 =
	<
	131	40900	8397
	262	40790	8473
	393	40680	8473
	524	40580	8397
	655	40490	8473
	786	40400	8473
	917	40320	8550
	1048	40230	8550
	1179	40140	8473
	1310	40070	8550
	1441	39990	8626
	1572	39920	8626
	1703	39850	8702
	1834	39790	8855
	1965	39710	8855
	2096	39650	8931
	2227	39580	9008
	2358	39510	9084
	2489	39450	9160
	2620	39380	9237
	2751	39300	9237
	2882	39220	9237
	3013	39140	9160
	3144	39070	9237
	3275	38980	9160
	3406	38890	9008
	3537	38810	9008
	3668	38730	8855
	3799	38660	8779
	3930	38580	8626
	4061	38520	8626
	4192	38460	8473
	4323	38420	8626
	4454	38360	8550
	4585	38320	8550
	4716	38270	8550
	4847	38240	8702
	4978	38200	8702
	5109	38160	8702
	5240	38130	8779
	5371	38090	8702
	5502	38060	8702
	5633	38030	8779
	5764	38000	8855
	5895	37980	8931
	6026	37950	8931
	6157	37930	9008
	6288	37910	9084
	6419	37890	9160
	6550	37880	9313
	6681	37860	9389
	6812	37850	9542
	6943	37820	9542
	7074	37810	9771
	7205	37790	9924
	7336	37780	10229
	7467	37760	10458
	7598	37750	10763
	7729	37720	10916
	7860	37700	11298
	7991	37670	11527
	8122	37660	11908
	8253	37630	12137
	8384	37610	12443
	8515	37580	12595
	8646	37570	12977
	8777	37540	13206
	8908	37520	13511
	9039	37500	13817
	9170	37470	13969
	9301	37440	14275
	9432	37420	14580
	9563	37390	14885
	9694	37350	15038
	9825	37320	15344
	9956	37290	15725
	10087	37250	15954
	10218	37210	16336
	10349	37160	16489
	10480	37110	16794
	10611	37060	17176
	10742	37000	17405
	10873	36940	17710
	11004	36870	18015
	11135	36790	18168
	11266	36710	18473
	11397	36620	18779
	11528	36530	19008
	11659	36430	19237
	11790	36320	19466
	11921	36200	19466
	12052	36090	19542
	12183	35980	19618
	12314	35890	19695
	12445	35810	19847
	12576	35720	20000
	12707	35640	20229
	12838	35560	20458
	12969	35480	20763
	13100	35400	21145
	>;
	battery0_profile_t4_num = <100>;
	battery0_profile_t4 =
	<
	114	40890	17193
	228	40740	17105
	342	40620	17193
	456	40510	17281
	570	40400	17193
	684	40300	17281
	798	40200	17281
	912	40110	17368
	1026	40020	17368
	1140	39940	17456
	1254	39860	17544
	1368	39790	17719
	1482	39710	17719
	1596	39640	17807
	1710	39570	17807
	1824	39500	17895
	1938	39440	18070
	2052	39380	18246
	2166	39300	18158
	2280	39230	18158
	2394	39170	18333
	2508	39100	18333
	2622	39030	18246
	2736	38960	18246
	2850	38900	18333
	2964	38830	18246
	3078	38770	18333
	3192	38700	18246
	3306	38640	18246
	3420	38580	18158
	3534	38520	18158
	3648	38480	18333
	3762	38430	18333
	3876	38380	18421
	3990	38330	18421
	4104	38290	18421
	4218	38260	18509
	4332	38220	18596
	4446	38190	18684
	4560	38160	18684
	4674	38130	18860
	4788	38100	18860
	4902	38080	19035
	5016	38060	19211
	5130	38040	19035
	5244	38020	19123
	5358	37990	19123
	5472	37980	19474
	5586	37970	19737
	5700	37950	20000
	5814	37940	20526
	5928	37910	20614
	6042	37900	21228
	6156	37880	21579
	6270	37860	22018
	6384	37850	22368
	6498	37830	22807
	6612	37800	23158
	6726	37790	23596
	6840	37770	23947
	6954	37750	24386
	7068	37730	24825
	7182	37700	25088
	7296	37690	25526
	7410	37670	25877
	7524	37640	26228
	7638	37620	26579
	7752	37600	26842
	7866	37580	27193
	7980	37550	27368
	8094	37530	27719
	8208	37510	28070
	8322	37480	28333
	8436	37450	28509
	8550	37420	28684
	8664	37390	29035
	8778	37360	29298
	8892	37330	29474
	9006	37290	29649
	9120	37260	30000
	9234	37220	30175
	9348	37180	30351
	9462	37140	30614
	9576	37100	30789
	9690	37060	31140
	9804	37010	31316
	9918	36970	31579
	10032	36910	31667
	10146	36860	31842
	10260	36810	32018
	10374	36760	32193
	10488	36700	32368
	10602	36640	32544
	10716	36590	32807
	10830	36520	32807
	10944	36460	32982
	11058	36390	33070
	11172	36320	33246
	11286	36260	33421
	11400	36190	33596
	>;


	/* Battery Care Profile */
	battery0_profile_care_mode_t0_num = <100>;
	battery0_profile_care_mode_t0_col = <3>;
	battery0_profile_care_mode_t0 =
	<
	158	41550	3038
	316	41420	2911
	474	41330	2911
	632	41230	2848
	790	41150	2848
	948	41060	2785
	1106	40990	2848
	1264	40920	2848
	1422	40840	2785
	1580	40770	2785
	1738	40690	2722
	1896	40610	2785
	2054	40530	2848
	2212	40450	2785
	2370	40370	2785
	2528	40290	2785
	2686	40210	2848
	2844	40140	2911
	3002	40060	2848
	3160	39980	2785
	3318	39910	2848
	3476	39840	2848
	3634	39760	2848
	3792	39690	2848
	3950	39630	2975
	4108	39550	2911
	4266	39480	2975
	4424	39410	3101
	4582	39330	3228
	4740	39230	3354
	4898	39110	3228
	5056	38980	2975
	5214	38890	2848
	5372	38800	2658
	5530	38740	2658
	5688	38690	2658
	5846	38630	2595
	6004	38580	2595
	6162	38530	2532
	6320	38480	2595
	6478	38440	2658
	6636	38390	2532
	6794	38350	2595
	6952	38310	2595
	7110	38270	2595
	7268	38230	2595
	7426	38190	2532
	7584	38150	2532
	7742	38110	2595
	7900	38080	2595
	8058	38040	2532
	8216	38010	2532
	8374	37980	2532
	8532	37950	2595
	8690	37920	2595
	8848	37890	2532
	9006	37860	2532
	9164	37830	2532
	9322	37810	2532
	9480	37790	2595
	9638	37760	2532
	9796	37750	2658
	9954	37720	2658
	10112	37690	2595
	10270	37660	2595
	10428	37600	2595
	10586	37540	2595
	10744	37490	2468
	10902	37470	2532
	11060	37440	2405
	11218	37410	2405
	11376	37390	2532
	11534	37350	2532
	11692	37320	2532
	11850	37280	2532
	12008	37240	2468
	12166	37220	2532
	12324	37190	2532
	12482	37140	2595
	12640	37100	2785
	12798	37030	2785
	12956	36950	2658
	13114	36900	2911
	13272	36810	2975
	13430	36710	2658
	13588	36660	2405
	13746	36650	2532
	13904	36630	2532
	14062	36610	2595
	14220	36590	2722
	14378	36560	2722
	14536	36530	2848
	14694	36480	2911
	14852	36420	3101
	15010	36340	3671
	15168	36180	4810
	15326	35850	5570
	15484	35410	6329
	15642	34870	7532
	15800	34180	9304
	>;
	battery0_profile_care_mode_t1_num = <100>;
	battery0_profile_care_mode_t1_col = <3>;
	battery0_profile_care_mode_t1 =
	<
	158	41550	3038
	316	41420	2911
	474	41330	2911
	632	41230	2848
	790	41150	2848
	948	41060	2785
	1106	40990	2848
	1264	40920	2848
	1422	40840	2785
	1580	40770	2785
	1738	40690	2722
	1896	40610	2785
	2054	40530	2848
	2212	40450	2785
	2370	40370	2785
	2528	40290	2785
	2686	40210	2848
	2844	40140	2911
	3002	40060	2848
	3160	39980	2785
	3318	39910	2848
	3476	39840	2848
	3634	39760	2848
	3792	39690	2848
	3950	39630	2975
	4108	39550	2911
	4266	39480	2975
	4424	39410	3101
	4582	39330	3228
	4740	39230	3354
	4898	39110	3228
	5056	38980	2975
	5214	38890	2848
	5372	38800	2658
	5530	38740	2658
	5688	38690	2658
	5846	38630	2595
	6004	38580	2595
	6162	38530	2532
	6320	38480	2595
	6478	38440	2658
	6636	38390	2532
	6794	38350	2595
	6952	38310	2595
	7110	38270	2595
	7268	38230	2595
	7426	38190	2532
	7584	38150	2532
	7742	38110	2595
	7900	38080	2595
	8058	38040	2532
	8216	38010	2532
	8374	37980	2532
	8532	37950	2595
	8690	37920	2595
	8848	37890	2532
	9006	37860	2532
	9164	37830	2532
	9322	37810	2532
	9480	37790	2595
	9638	37760	2532
	9796	37750	2658
	9954	37720	2658
	10112	37690	2595
	10270	37660	2595
	10428	37600	2595
	10586	37540	2595
	10744	37490	2468
	10902	37470	2532
	11060	37440	2405
	11218	37410	2405
	11376	37390	2532
	11534	37350	2532
	11692	37320	2532
	11850	37280	2532
	12008	37240	2468
	12166	37220	2532
	12324	37190	2532
	12482	37140	2595
	12640	37100	2785
	12798	37030	2785
	12956	36950	2658
	13114	36900	2911
	13272	36810	2975
	13430	36710	2658
	13588	36660	2405
	13746	36650	2532
	13904	36630	2532
	14062	36610	2595
	14220	36590	2722
	14378	36560	2722
	14536	36530	2848
	14694	36480	2911
	14852	36420	3101
	15010	36340	3671
	15168	36180	4810
	15326	35850	5570
	15484	35410	6329
	15642	34870	7532
	15800	34180	9304
	>;
	battery0_profile_care_mode_t2_num = <100>;
	battery0_profile_care_mode_t2_col = <3>;
	battery0_profile_care_mode_t2 =
	<
	142	40960	5282
	284	40840	5141
	426	40740	5070
	568	40650	5141
	710	40570	5070
	852	40480	5070
	994	40400	5141
	1136	40320	5141
	1278	40240	5141
	1420	40170	5211
	1562	40100	5282
	1704	40020	5282
	1846	39950	5282
	1988	39880	5352
	2130	39820	5423
	2272	39740	5352
	2414	39680	5493
	2556	39610	5493
	2698	39550	5634
	2840	39480	5704
	2982	39400	5775
	3124	39330	5915
	3266	39230	5775
	3408	39140	5775
	3550	39040	5704
	3692	38930	5563
	3834	38830	5282
	3976	38740	5141
	4118	38670	5070
	4260	38610	5000
	4402	38550	4930
	4544	38500	4930
	4686	38450	4930
	4828	38410	5000
	4970	38360	4930
	5112	38320	5000
	5254	38280	4930
	5396	38240	4930
	5538	38200	4859
	5680	38170	4930
	5822	38140	5000
	5964	38100	5000
	6106	38070	5000
	6248	38030	5000
	6390	38000	5000
	6532	37970	5000
	6674	37940	5000
	6816	37920	5000
	6958	37890	5070
	7100	37860	4930
	7242	37850	5070
	7384	37820	5000
	7526	37800	5000
	7668	37790	5070
	7810	37770	5070
	7952	37760	5070
	8094	37750	5282
	8236	37730	5282
	8378	37720	5423
	8520	37700	5563
	8662	37690	5704
	8804	37670	5775
	8946	37640	5845
	9088	37630	6056
	9230	37600	6127
	9372	37580	6268
	9514	37560	6408
	9656	37530	6549
	9798	37510	6690
	9940	37480	6831
	10082	37450	6901
	10224	37410	7042
	10366	37380	7254
	10508	37350	7465
	10650	37300	7606
	10792	37260	7817
	10934	37220	8099
	11076	37170	8380
	11218	37110	8592
	11360	37050	8944
	11502	36980	9296
	11644	36890	9577
	11786	36810	9930
	11928	36720	10352
	12070	36610	10634
	12212	36500	10775
	12354	36400	10775
	12496	36320	10986
	12638	36250	11197
	12780	36170	11338
	12922	36080	11408
	13064	35990	11549
	13206	35900	11690
	13348	35800	11831
	13490	35690	11972
	13632	35580	12183
	13774	35460	12535
	13916	35310	13169
	14058	35090	14014
	14200	34750	15000
	>;
	battery0_profile_care_mode_t3_num = <100>;
	battery0_profile_care_mode_t3_col = <3>;
	battery0_profile_care_mode_t3 =
	<
	131	40900	8397
	262	40790	8473
	393	40680	8473
	524	40580	8397
	655	40490	8473
	786	40400	8473
	917	40320	8550
	1048	40230	8550
	1179	40140	8473
	1310	40070	8550
	1441	39990	8626
	1572	39920	8626
	1703	39850	8702
	1834	39790	8855
	1965	39710	8855
	2096	39650	8931
	2227	39580	9008
	2358	39510	9084
	2489	39450	9160
	2620	39380	9237
	2751	39300	9237
	2882	39220	9237
	3013	39140	9160
	3144	39070	9237
	3275	38980	9160
	3406	38890	9008
	3537	38810	9008
	3668	38730	8855
	3799	38660	8779
	3930	38580	8626
	4061	38520	8626
	4192	38460	8473
	4323	38420	8626
	4454	38360	8550
	4585	38320	8550
	4716	38270	8550
	4847	38240	8702
	4978	38200	8702
	5109	38160	8702
	5240	38130	8779
	5371	38090	8702
	5502	38060	8702
	5633	38030	8779
	5764	38000	8855
	5895	37980	8931
	6026	37950	8931
	6157	37930	9008
	6288	37910	9084
	6419	37890	9160
	6550	37880	9313
	6681	37860	9389
	6812	37850	9542
	6943	37820	9542
	7074	37810	9771
	7205	37790	9924
	7336	37780	10229
	7467	37760	10458
	7598	37750	10763
	7729	37720	10916
	7860	37700	11298
	7991	37670	11527
	8122	37660	11908
	8253	37630	12137
	8384	37610	12443
	8515	37580	12595
	8646	37570	12977
	8777	37540	13206
	8908	37520	13511
	9039	37500	13817
	9170	37470	13969
	9301	37440	14275
	9432	37420	14580
	9563	37390	14885
	9694	37350	15038
	9825	37320	15344
	9956	37290	15725
	10087	37250	15954
	10218	37210	16336
	10349	37160	16489
	10480	37110	16794
	10611	37060	17176
	10742	37000	17405
	10873	36940	17710
	11004	36870	18015
	11135	36790	18168
	11266	36710	18473
	11397	36620	18779
	11528	36530	19008
	11659	36430	19237
	11790	36320	19466
	11921	36200	19466
	12052	36090	19542
	12183	35980	19618
	12314	35890	19695
	12445	35810	19847
	12576	35720	20000
	12707	35640	20229
	12838	35560	20458
	12969	35480	20763
	13100	35400	21145
	>;
	battery0_profile_care_mode_t4_num = <100>;
	battery0_profile_care_mode_t4_col = <3>;
	battery0_profile_care_mode_t4 =
	<
	114	40890	17193
	228	40740	17105
	342	40620	17193
	456	40510	17281
	570	40400	17193
	684	40300	17281
	798	40200	17281
	912	40110	17368
	1026	40020	17368
	1140	39940	17456
	1254	39860	17544
	1368	39790	17719
	1482	39710	17719
	1596	39640	17807
	1710	39570	17807
	1824	39500	17895
	1938	39440	18070
	2052	39380	18246
	2166	39300	18158
	2280	39230	18158
	2394	39170	18333
	2508	39100	18333
	2622	39030	18246
	2736	38960	18246
	2850	38900	18333
	2964	38830	18246
	3078	38770	18333
	3192	38700	18246
	3306	38640	18246
	3420	38580	18158
	3534	38520	18158
	3648	38480	18333
	3762	38430	18333
	3876	38380	18421
	3990	38330	18421
	4104	38290	18421
	4218	38260	18509
	4332	38220	18596
	4446	38190	18684
	4560	38160	18684
	4674	38130	18860
	4788	38100	18860
	4902	38080	19035
	5016	38060	19211
	5130	38040	19035
	5244	38020	19123
	5358	37990	19123
	5472	37980	19474
	5586	37970	19737
	5700	37950	20000
	5814	37940	20526
	5928	37910	20614
	6042	37900	21228
	6156	37880	21579
	6270	37860	22018
	6384	37850	22368
	6498	37830	22807
	6612	37800	23158
	6726	37790	23596
	6840	37770	23947
	6954	37750	24386
	7068	37730	24825
	7182	37700	25088
	7296	37690	25526
	7410	37670	25877
	7524	37640	26228
	7638	37620	26579
	7752	37600	26842
	7866	37580	27193
	7980	37550	27368
	8094	37530	27719
	8208	37510	28070
	8322	37480	28333
	8436	37450	28509
	8550	37420	28684
	8664	37390	29035
	8778	37360	29298
	8892	37330	29474
	9006	37290	29649
	9120	37260	30000
	9234	37220	30175
	9348	37180	30351
	9462	37140	30614
	9576	37100	30789
	9690	37060	31140
	9804	37010	31316
	9918	36970	31579
	10032	36910	31667
	10146	36860	31842
	10260	36810	32018
	10374	36760	32193
	10488	36700	32368
	10602	36640	32544
	10716	36590	32807
	10830	36520	32807
	10944	36460	32982
	11058	36390	33070
	11172	36320	33246
	11286	36260	33421
	11400	36190	33596
	>;
};
