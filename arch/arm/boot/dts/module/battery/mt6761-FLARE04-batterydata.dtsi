/*
 * This software is contributed or developed by KYOCERA Corporation.
 * (C) 2020 KYOCERA Corporation
 *
 * This program is free software; you can redistribute it and/or modify
 * it under the terms of the GNU General Public License version 2 and
 * only version 2 as published by the Free Software Foundation.
 *
 * This program is distributed in the hope that it will be useful,
 * but WITHOUT ANY WARRANTY; without even the implied warranty of
 * MERCHANTABILITY or FITNESS FOR A PARTICULAR PURPOSE.  See the
 * GNU General Public License for more details.
 */

&odm {
	kc_deter_param {
		oem,deterioration-thresh-good = <80>;
		oem,deterioration-thresh-norm = <50>;
		oem,deterioration-thresh-normtogood = <85>;
		oem,deterioration-thresh-deadtonorm = <60>;
	};
};

&bat_gm30 {
	EMBEDDED_SEL = <(1)>;

	/* Aging Compensation 1*/
	AGING_FACTOR_MIN = <(40)>;
	AGING_FACTOR_DIFF = <(5)>;
	AGING_TEMP_DIFF = <(30)>;
	AGING_TEMP_LOW_LIMIT = <(15)>;
	AGING_TEMP_HIGH_LIMIT = <(50)>;
	AGING1_LOAD_SOC = <(60)>;
	AGING_4_EN = <(0)>;
	AGING_5_EN = <(0)>;
	AGING_6_EN = <(0)>;
};

&bat_gm30 {
	/* Battery Profile */
	battery0_profile_t0_num = <100>;
	battery0_profile_t0 =
	<
	138	42480	1498
	276	42360	1498
	414	42240	1498
	552	42120	1498
	690	42000	1498
	827	41896	1510
	965	41792	1523
	1103	41688	1535
	1241	41584	1548
	1379	41480	1560
	1517	41380	1568
	1655	41280	1577
	1793	41180	1585
	1931	41080	1593
	2069	40980	1602
	2206	40898	1627
	2344	40816	1652
	2482	40734	1676
	2620	40652	1701
	2758	40570	1726
	2896	40464	1722
	3034	40358	1718
	3172	40252	1714
	3310	40146	1710
	3448	40040	1706
	3585	39970	1726
	3723	39900	1747
	3861	39830	1768
	3999	39760	1789
	4137	39690	1810
	4275	39624	1830
	4413	39558	1851
	4551	39492	1872
	4689	39426	1893
	4827	39360	1914
	4964	39284	1909
	5102	39208	1905
	5240	39132	1901
	5378	39056	1897
	5516	38980	1893
	5654	38896	1843
	5792	38812	1793
	5930	38728	1743
	6068	38644	1693
	6206	38560	1643
	6343	38504	1627
	6481	38448	1610
	6619	38392	1593
	6757	38336	1577
	6895	38280	1560
	7033	38238	1568
	7171	38196	1577
	7309	38154	1585
	7447	38112	1593
	7584	38050	1602
	7722	38040	1610
	7860	38010	1618
	7998	37980	1627
	8136	37950	1635
	8274	37920	1643
	8412	37892	1652
	8550	37864	1660
	8688	37836	1668
	8826	37808	1676
	8963	37780	1685
	9101	37756	1689
	9239	37732	1693
	9377	37708	1697
	9515	37684	1701
	9653	37660	1706
	9791	37634	1701
	9929	37608	1697
	10067	37582	1693
	10205	37556	1689
	10343	37530	1685
	10480	37490	1681
	10618	37450	1676
	10756	37410	1672
	10894	37370	1668
	11032	37330	1664
	11170	37273	1659
	11308	37215	1654
	11446	37158	1648
	11584	37100	1643
	11722	37040	1636
	11859	36980	1629
	11997	36920	1622
	12135	36875	1633
	12273	36830	1643
	12411	36810	1685
	12549	36800	1726
	12687	36790	1768
	12825	36780	1810
	12963	36760	1851
	13101	36690	1830
	13238	36500	1789
	13376	36120	1768
	13514	35580	1830
	13652	34920	1955
	13790	34000	1955
	>;
	battery0_profile_t1_num = <100>;
	battery0_profile_t1 =
	<
	138	42514	2080
	276	42388	2080
	414	42262	2080
	552	42136	2080
	690	42010	2080
	827	41906	2105
	965	41802	2129
	1103	41698	2154
	1241	41594	2179
	1379	41490	2203
	1517	41388	2218
	1655	41286	2233
	1793	41184	2248
	1931	41082	2263
	2069	40980	2278
	2206	40908	2325
	2344	40836	2371
	2482	40764	2417
	2620	40692	2464
	2758	40620	2510
	2896	40494	2474
	3034	40368	2437
	3172	40242	2401
	3310	40116	2365
	3448	39990	2328
	3585	39926	2351
	3723	39862	2374
	3861	39798	2396
	3999	39734	2419
	4137	39670	2442
	4275	39604	2397
	4413	39538	2353
	4551	39472	2308
	4689	39406	2264
	4827	39340	2219
	4964	39258	2150
	5102	39176	2082
	5240	39094	2013
	5378	39012	1944
	5516	38930	1875
	5654	38850	1880
	5792	38770	1884
	5930	38690	1888
	6068	38610	1892
	6206	38530	1897
	6343	38476	1925
	6481	38422	1953
	6619	38368	1982
	6757	38314	2010
	6895	38260	2038
	7033	38218	2069
	7171	38176	2101
	7309	38134	2132
	7447	38092	2163
	7584	38050	2194
	7722	38022	2205
	7860	37994	2217
	7998	37966	2228
	8136	37938	2240
	8274	37910	2251
	8412	37886	2244
	8550	37862	2238
	8688	37838	2231
	8826	37814	2224
	8963	37790	2218
	9101	37774	2264
	9239	37758	2311
	9377	37742	2357
	9515	37726	2404
	9653	37710	2450
	9791	37690	2461
	9929	37670	2472
	10067	37650	2483
	10205	37630	2493
	10343	37610	2504
	10480	37574	2484
	10618	37538	2465
	10756	37502	2445
	10894	37466	2425
	11032	37430	2405
	11170	37373	2375
	11308	37315	2344
	11446	37258	2313
	11584	37200	2282
	11722	37133	2522
	11859	37067	2762
	11997	37000	3002
	12135	36955	3673
	12273	36910	4344
	12411	36890	4426
	12549	36870	6354
	12687	36860	5658
	12825	36850	3812
	12963	36830	3490
	13101	36770	3307
	13238	36620	3029
	13376	36280	2861
	13514	35760	3413
	13652	35080	6614
	13790	34000	6614
	>;
	battery0_profile_t2_num = <100>;
	battery0_profile_t2 =
	<
	93	42534	4077
	186	42398	4077
	278	42262	4077
	371	42126	4077
	464	41990	4077
	557	41884	4093
	650	41778	4110
	742	41672	4127
	835	41566	4143
	928	41460	4160
	1021	41364	4177
	1114	41268	4193
	1206	41172	4210
	1299	41076	4227
	1392	40980	4243
	1485	40902	4326
	1578	40824	4410
	1670	40746	4493
	1763	40668	4576
	1856	40590	4659
	1949	40454	4588
	2042	40318	4518
	2134	40182	4447
	2227	40046	4376
	2320	39910	4306
	2413	39842	4326
	2506	39774	4347
	2598	39706	4368
	2691	39638	4389
	2784	39570	4410
	2877	39488	4360
	2970	39406	4310
	3062	39324	4260
	3155	39242	4210
	3248	39160	4160
	3341	39082	4110
	3434	39004	4060
	3526	38926	4010
	3619	38848	3960
	3712	38770	3910
	3805	38704	3890
	3898	38638	3869
	3990	38572	3848
	4083	38506	3827
	4176	38440	3806
	4269	38394	3815
	4362	38348	3823
	4454	38302	3831
	4547	38256	3840
	4640	38210	3848
	4733	38170	3860
	4826	38130	3873
	4918	38090	3885
	5011	38050	3898
	5104	38010	3910
	5197	37984	3940
	5290	37958	3969
	5382	37932	3998
	5475	37906	4027
	5568	37880	4056
	5661	37864	4110
	5754	37848	4164
	5846	37832	4218
	5939	37816	4272
	6032	37800	4326
	6125	37784	4393
	6218	37768	4460
	6310	37752	4526
	6403	37736	4593
	6496	37720	4659
	6589	37698	4738
	6682	37676	4817
	6774	37654	4896
	6867	37632	4975
	6960	37610	5054
	7053	37572	5113
	7146	37534	5171
	7238	37496	5229
	7331	37458	5287
	7424	37420	5346
	7517	37365	5387
	7610	37310	5429
	7702	37255	5470
	7795	37200	5512
	7888	37150	5595
	7981	37100	5678
	8074	37050	5762
	8166	37010	5897
	8259	36970	6032
	8352	36950	6240
	8445	36930	6386
	8538	36910	6490
	8630	36890	6614
	8723	36860	6802
	8816	36810	7093
	8909	36670	7342
	9002	36370	7571
	9094	35890	8008
	9187	35220	8840
	9280	34000	8840
	>;
	battery0_profile_t3_num = <100>;
	battery0_profile_t3 =
	<
	93	42530	7904
	186	42380	7904
	280	42230	7904
	373	42080	7904
	467	41930	7904
	560	41824	7912
	654	41718	7921
	747	41612	7929
	841	41506	7937
	934	41400	7946
	1028	41312	7975
	1121	41224	8004
	1215	41136	8033
	1308	41048	8062
	1402	40960	8091
	1495	40868	8108
	1589	40776	8124
	1682	40684	8141
	1776	40592	8158
	1869	40500	8174
	1963	40340	8016
	2056	40180	7858
	2150	40020	7700
	2243	39860	7542
	2337	39700	7384
	2430	39616	7367
	2524	39532	7351
	2617	39448	7334
	2711	39364	7317
	2804	39280	7301
	2898	39212	7292
	2991	39144	7284
	3085	39076	7276
	3178	39008	7268
	3272	38940	7259
	3365	38880	7255
	3459	38820	7251
	3552	38760	7247
	3646	38700	7243
	3739	38640	7238
	3833	38584	7243
	3926	38528	7247
	4020	38472	7251
	4113	38416	7255
	4207	38360	7259
	4300	38316	7284
	4394	38272	7309
	4487	38228	7334
	4581	38184	7359
	4674	38140	7384
	4768	38108	7438
	4861	38076	7492
	4955	38044	7546
	5048	38012	7600
	5142	37980	7654
	5235	37958	7729
	5329	37936	7804
	5422	37914	7879
	5516	37892	7954
	5609	37870	8029
	5703	37848	8116
	5796	37826	8204
	5890	37804	8291
	5983	37782	8378
	6077	37760	8466
	6170	37738	8565
	6264	37716	8665
	6357	37694	8765
	6451	37672	8865
	6544	37650	8965
	6638	37616	9056
	6731	37582	9148
	6825	37548	9239
	6918	37514	9331
	7012	37480	9422
	7105	37438	9547
	7199	37396	9672
	7292	37354	9797
	7386	37312	9922
	7479	37270	10046
	7573	37238	10254
	7666	37205	10462
	7760	37173	10670
	7853	37140	10878
	7947	37117	11170
	8040	37093	11461
	8134	37070	11752
	8227	37050	12085
	8321	37030	12418
	8414	37010	12730
	8508	36990	12792
	8601	36960	12750
	8695	36910	12646
	8788	36850	12750
	8882	36760	13166
	8975	36610	13707
	9069	36350	14310
	9162	35920	15122
	9256	35300	16307
	9349	34000	16307
	>;
	battery0_profile_t4_num = <100>;
	battery0_profile_t4 =
	<
	55	42512	15080
	111	42344	15080
	166	42176	15080
	221	42008	15080
	277	41840	15080
	332	41724	14926
	387	41608	14772
	442	41492	14618
	498	41376	14464
	553	41260	14310
	608	41172	14244
	664	41084	14177
	719	40996	14111
	774	40908	14044
	830	40820	13978
	885	40672	13782
	940	40524	13587
	995	40376	13391
	1051	40228	13196
	1106	40080	13000
	1161	39960	12904
	1217	39840	12809
	1272	39720	12713
	1327	39600	12617
	1383	39480	12522
	1438	39400	12513
	1493	39320	12505
	1548	39240	12497
	1604	39160	12488
	1659	39080	12480
	1714	39014	12484
	1770	38948	12488
	1825	38882	12492
	1880	38816	12497
	1936	38750	12501
	1991	38694	12513
	2046	38638	12526
	2101	38582	12538
	2157	38526	12551
	2212	38470	12563
	2267	38426	12592
	2323	38382	12621
	2378	38338	12651
	2433	38294	12680
	2489	38250	12709
	2544	38212	12759
	2599	38174	12809
	2654	38136	12859
	2710	38098	12908
	2765	38060	12958
	2820	38026	13025
	2876	37992	13092
	2931	37958	13158
	2986	37924	13225
	3042	37890	13291
	3097	37858	13383
	3152	37826	13474
	3207	37794	13566
	3263	37762	13657
	3318	37730	13749
	3373	37702	13874
	3429	37674	13998
	3484	37646	14123
	3539	37618	14248
	3595	37590	14373
	3650	37562	14531
	3705	37534	14689
	3760	37506	14847
	3816	37478	15005
	3871	37450	15163
	3926	37428	15363
	3982	37406	15563
	4037	37384	15762
	4092	37362	15962
	4148	37340	16162
	4203	37320	16399
	4258	37300	16636
	4313	37280	16873
	4369	37260	17110
	4424	37240	17347
	4479	37223	17628
	4535	37205	17909
	4590	37188	18190
	4645	37170	18470
	4701	37140	18769
	4756	37110	19067
	4811	37080	19365
	4866	37045	19625
	4922	37010	19885
	4977	36970	20093
	5032	36920	19968
	5088	36850	19781
	5143	36780	19573
	5198	36690	19739
	5254	36550	20363
	5309	36370	21507
	5364	36120	23483
	5419	35760	27019
	5475	35210	33384
	5530	34000	33384
	>;
};
