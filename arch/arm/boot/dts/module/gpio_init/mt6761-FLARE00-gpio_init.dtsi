
&gpio{
    /*  <PIN MODE DIR DOUT PULL_EN PULL_SEL SMT>  */
    kc_gpio_init_default = <0 0 0 0 1 0 1>,
        <1 0 0 0 1 0 1>,
        <3 0 0 0 1 1 1>,
        <4 0 0 0 1 1 1>,
        <5 0 0 0 1 1 1>,
        <6 0 0 0 0 0 1>,
        <7 0 0 0 1 0 1>,
        <8 0 0 0 1 1 1>,
        <9 0 0 0 1 1 1>,
        <10 0 0 0 1 1 1>,
        <12 0 0 0 1 0 1>,
        <13 0 0 0 1 0 1>,
        <14 0 0 0 1 0 1>,
        <15 0 0 0 1 0 1>,
        <16 0 0 0 1 0 1>,
        <17 0 0 0 1 0 1>,
        <18 0 0 0 1 0 1>,
        <19 0 0 0 1 0 1>,
        <20 0 0 0 1 0 1>,
        <21 0 0 0 1 1 1>,
        <22 0 0 0 1 1 1>,
        <23 0 1 0 0 0 1>,
        <24 0 0 0 1 1 1>,
        <25 0 1 0 0 0 1>,
        <26 0 1 0 0 0 1>,
        <27 0 1 0 0 0 1>,
        <28 0 1 0 0 0 1>,
        <35 0 0 0 1 0 1>,
        <36 0 0 0 1 0 1>,
        <37 0 0 0 1 0 1>,
        <41 0 0 0 1 1 1>,
        <42 0 1 0 0 0 1>,
        <43 0 0 0 1 0 1>,
        <44 0 0 0 1 0 1>,
        <45 0 1 0 0 0 1>,
        <46 0 0 0 1 0 1>,
        <50 1 0 0 1 1 1>,
        <51 1 0 0 1 1 1>,
        <52 0 0 0 1 1 1>,
        <53 0 0 0 1 0 1>,
        <54 0 1 0 0 0 1>,
        <55 0 0 0 1 0 1>,
        <56 0 0 0 1 0 1>,
        <57 0 0 0 1 0 1>,
        <58 0 0 0 1 0 1>,
        <65 0 0 0 1 0 1>,
        <66 0 0 0 1 0 1>,
        <69 0 0 0 1 0 1>,
        <70 0 0 0 1 0 1>,
        <71 0 0 0 1 0 1>,
        <72 0 0 0 1 0 1>,
        <73 0 0 0 1 0 1>,
        <74 0 0 0 1 0 1>,
        <75 0 0 0 1 0 1>,
        <76 0 0 0 1 0 1>,
        <77 0 0 0 1 0 1>,
        <78 0 0 0 1 0 1>,
        <79 0 1 0 0 0 1>,
        <80 0 0 0 1 1 1>,
        <81 1 0 0 1 1 1>,
        <82 1 0 0 1 1 1>,
        <83 1 0 0 1 1 1>,
        <84 1 0 0 1 1 1>,
        <87 0 1 0 0 0 1>,
        <88 0 1 0 0 0 1>,
        <89 0 0 0 1 0 1>,
        <90 0 0 0 1 0 1>,
        <92 0 1 0 0 0 1>,
        <93 0 0 0 1 1 1>,
        <94 0 0 0 1 1 1>,
        <97 0 0 0 1 0 1>,
        <98 0 0 0 1 0 1>,
        <99 0 1 0 0 0 1>,
        <100 0 0 0 1 0 1>,
        <101 0 1 0 0 0 1>,
        <102 0 0 0 1 0 1>,
        <103 0 0 0 1 0 1>,
        <104 0 0 0 1 0 1>,
        <105 1 0 0 1 1 1>,
        <106 1 0 0 1 1 1>,
        <107 0 0 0 1 1 1>,
        <108 0 0 0 1 1 1>,
        <109 0 0 0 1 1 1>,
        <110 0 0 0 1 0 1>,
        <111 0 1 0 0 0 1>,
        <112 0 0 0 1 0 1>,
        <150 0 1 0 0 0 1>,
        <151 0 1 0 0 0 1>,
        <152 0 0 0 1 0 1>,
        <153 0 1 0 0 0 1>,
        <154 0 1 0 1 0 1>,
        <155 0 0 0 1 0 1>,
        <156 0 0 0 1 0 1>,
        <157 0 0 0 1 0 1>,
        <158 0 0 0 1 0 1>,
        <159 0 1 0 0 0 1>,
        <160 0 0 0 1 0 1>,
        <161 1 0 0 1 1 1>,
        <162 1 0 0 1 1 1>,
        <163 0 0 0 1 0 1>,
        <164 0 0 0 1 0 1>,
        <165 0 0 0 1 0 1>,
        <166 0 0 0 1 0 1>,
        <167 0 0 0 1 0 1>,
        <168 0 0 0 1 0 1>,
        <169 0 0 0 1 0 1>,
        <170 0 0 0 1 0 1>,
        <171 0 0 0 1 0 1>,
        <172 0 0 0 1 0 1>,
        <173 0 1 1 0 0 1>,
        <174 0 1 0 0 0 1>,
        <175 0 0 0 1 0 1>,
        <176 0 0 0 1 0 1>,
        <177 0 0 0 1 0 1>,
        <178 0 0 0 1 0 1>,
        <179 0 0 0 0 0 0>;
};

&gpio{
    /*  <PIN DRIVE>  */
    kc_gpio_init_drv = <0 0>,
        <1 0>,
        <3 0>,
        <4 0>,
        <5 0>,
        <6 0>,
        <7 0>,
        <8 0>,
        <9 0>,
        <10 0>,
        <12 0>,
        <13 0>,
        <14 0>,
        <15 0>,
        <16 0>,
        <17 0>,
        <18 0>,
        <19 0>,
        <20 0>,
        <21 0>,
        <22 0>,
        <23 0>,
        <24 0>,
        <25 0>,
        <26 0>,
        <27 0>,
        <28 0>,
        <35 0>,
        <36 0>,
        <37 0>,
        <41 0>,
        <42 0>,
        <43 0>,
        <44 0>,
        <45 0>,
        <46 0>,
        <50 0>,
        <51 0>,
        <52 0>,
        <53 0>,
        <54 0>,
        <55 0>,
        <56 0>,
        <57 0>,
        <58 1>,
        <65 0>,
        <66 0>,
        <69 0>,
        <70 0>,
        <71 0>,
        <72 0>,
        <73 0>,
        <74 0>,
        <75 0>,
        <76 0>,
        <77 0>,
        <78 0>,
        <79 0>,
        <80 0>,
        <81 0>,
        <82 0>,
        <83 0>,
        <84 0>,
        <87 0>,
        <88 0>,
        <89 0>,
        <90 0>,
        <92 0>,
        <93 0>,
        <94 0>,
        <97 0>,
        <98 0>,
        <99 1>,
        <100 0>,
        <101 0>,
        <102 0>,
        <103 0>,
        <104 0>,
        <105 0>,
        <106 0>,
        <107 0>,
        <108 0>,
        <109 0>,
        <110 0>,
        <111 0>,
        <112 0>,
        <150 0>,
        <151 0>,
        <152 0>,
        <153 0>,
        <154 0>,
        <155 0>,
        <156 0>,
        <157 0>,
        <158 0>,
        <159 0>,
        <160 0>,
        <161 0>,
        <162 0>,
        <163 0>,
        <164 0>,
        <165 0>,
        <166 0>,
        <167 0>,
        <168 0>,
        <169 0>,
        <170 0>,
        <171 0>,
        <172 0>,
        <173 0>,
        <174 0>,
        <175 0>,
        <176 0>,
        <177 0>,
        <178 0>,
        <179 0>;
};

&gpio{
    /*  <PIN R0 R1>  */
    kc_gpio_init_r0r1 = <35 0 1>,
        <36 0 1>,
        <37 0 1>,
        <92 0 1>,
        <93 0 1>,
        <94 0 1>,
        <179 0 0>;
};

