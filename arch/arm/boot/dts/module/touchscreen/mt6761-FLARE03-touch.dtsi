/*
 * This software is contributed or developed by KYOCERA Corporation.
 * (C) 2022 KYOCERA Corporation
 *
 * This program is free software; you can redistribute it and/or modify
 * it under the terms of the GNU General Public License version 2 and
 * only version 2 as published by the Free Software Foundation.
 *
 * This program is distributed in the hope that it will be useful,
 * but WITHOUT ANY WARRANTY; without even the implied warranty of
 * MERCHANTABILITY or FITNESS FOR A PARTICULAR PURPOSE.  See the
 * GNU General Public License for more details.
 */

&odm {
//	/delete-node/ keyptr;

	keyptr {
		compatible = "kc,keyptr";

		kc,panel-width = <240>;
		kc,panel-height = <320>;
		kc,move-step = <5>;
		kc,move-init-interval = <50>;
		kc,move-interval = <20>;
		kc,enabled;
    };
};

