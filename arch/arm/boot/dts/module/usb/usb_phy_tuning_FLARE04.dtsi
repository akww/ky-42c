/*
 * This software is contributed or developed by KYOCERA Corporation.
 * (C) 2022 KYOCERA Corporation
 *
 * This program is free software; you can redistribute it and/or modify
 * it under the terms of the GNU General Public License version 2 and
 * only version 2 as published by the Free Software Foundation.
 *
 * This program is distributed in the hope that it will be useful,
 * but WITHOUT ANY WARRANTY; without even the implied warranty of
 * MERCHANTABILITY or FITNESS FOR A PARTICULAR PURPOSE.  See the
 * GNU General Public License for more details.
 */

&odm {
	usb_phy_tuning: usb_phy_tuning {
		compatible  = "mediatek,phy_tuning";
		u2_hstx_srctrl = <7>;
		u2_vrt_ref     = <7>;
		u2_term_ref    = <4>;
		u2_enhance     = <2>;
		u2_sqth        = <3>;
		u2_discth      = <15>;
	};
};
