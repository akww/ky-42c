/*
 * This software is contributed or developed by KYOCERA Corporation.
 * (C) 2022 KYOCERA Corporation
 *
 * This program is free software; you can redistribute it and/or modify
 * it under the terms of the GNU General Public License version 2 and
 * only version 2 as published by the Free Software Foundation.
 *
 * This program is distributed in the hope that it will be useful,
 * but WITHOUT ANY WARRANTY; without even the implied warranty of
 * MERCHANTABILITY or FITNESS FOR A PARTICULAR PURPOSE.  See the
 * GNU General Public License for more details.
 */

#include "module/charger/mt6761-FLARE-common-charger.dtsi"
#include "module/hkadc/mt6761-FLARE-common-hkadc.dtsi"
#include "module/battery/mt6761-FLARE-common-batterydata.dtsi"
#include "module/iicd/mt6761-FLARE-iicd.dtsi"
#include "module/msdc/mt6761-FLARE-common-msdc.dtsi"
