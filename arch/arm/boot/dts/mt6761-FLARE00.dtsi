/*
 * This software is contributed or developed by KYOCERA Corporation.
 * (C) 2022 KYOCERA Corporation
 *
 * This program is free software; you can redistribute it and/or modify
 * it under the terms of the GNU General Public License version 2 and
 * only version 2 as published by the Free Software Foundation.
 *
 * This program is distributed in the hope that it will be useful,
 * but WITHOUT ANY WARRANTY; without even the implied warranty of
 * MERCHANTABILITY or FITNESS FOR A PARTICULAR PURPOSE.  See the
 * GNU General Public License for more details.
 */

#include "module/gpio_init/mt6761-FLARE00-gpio_init.dtsi"
#include "module/gps/mt6761-FLARE00-gps.dtsi"
#include "module/key/mt6761-FLARE00-key.dtsi"
#include "module/key/mt6761-FLARE00-matrix.dtsi"
#include "module/audio/mt6761-FLARE00-audio.dtsi"
#include "module/vibrator/mt6761-FLARE00-vibrator.dtsi"
#include "module/display/mt6761-FLARE00-display.dtsi"
#include "module/display/mt6761-FLARE00-sub_display.dtsi"
#include "module/touchscreen/mt6761-FLARE00-touch.dtsi"
#include "module/lights/mt6761-FLARE00-lights.dtsi"
#include "module/camera/mt6761-FLARE01-camera.dtsi"
#include "module/msdc/mt6761-FLARE00-msdc.dtsi" 
