/*
 * This software is contributed or developed by KYOCERA Corporation.
 * (C) 2022 KYOCERA Corporation
 *
 * This program is free software; you can redistribute it and/or modify
 * it under the terms of the GNU General Public License version 2 and
 * only version 2 as published by the Free Software Foundation.
 *
 * This program is distributed in the hope that it will be useful,
 * but WITHOUT ANY WARRANTY; without even the implied warranty of
 * MERCHANTABILITY or FITNESS FOR A PARTICULAR PURPOSE.  See the
 * GNU General Public License for more details.
 */
#include "module/gpio_init/mt6761-FLARE03-gpio_init.dtsi"
#include "module/usb/usb_phy_tuning_FLARE03.dtsi"
#include "module/camera/mt6761-FLARE03-camera.dtsi"
#include "module/gps/mt6761-FLARE03-gps.dtsi"
#include "module/key/mt6761-FLARE03-key.dtsi"
#include "module/key/mt6761-FLARE03-matrix.dtsi"
#include "module/audio/mt6761-FLARE03-audio.dtsi"
#include "module/vibrator/mt6761-FLARE03-vibrator.dtsi"
#include "module/charger/mt6761-FLARE03-charger.dtsi"
#include "module/display/mt6761-FLARE03-display.dtsi"
#include "module/display/mt6761-FLARE03-sub_display.dtsi"
#include "module/touchscreen/mt6761-FLARE03-touch.dtsi"
#include "module/lights/mt6761-FLARE03_lights.dtsi"
#include "module/battery/mt6761-FLARE03-batterydata.dtsi"
#include "module/msdc/mt6761-FLARE00-msdc.dtsi" 
