/*
 * This software is contributed or developed by KYOCERA Corporation.
 * (C) 2022 KYOCERA Corporation
 *
 * This program is free software; you can redistribute it and/or modify
 * it under the terms of the GNU General Public License version 2 and
 * only version 2 as published by the Free Software Foundation.
 *
 * This program is distributed in the hope that it will be useful,
 * but WITHOUT ANY WARRANTY; without even the implied warranty of
 * MERCHANTABILITY or FITNESS FOR A PARTICULAR PURPOSE.  See the
 * GNU General Public License for more details.
 */

#include "module/vibrator/mt6761-FLARE04-vibrator.dtsi"
#include "module/msdc/mt6761-FLARE04-msdc.dtsi" 
#include "module/key/mt6761-FLARE04-key.dtsi"
#include "module/sensors/mt6761-FLARE04-sensors.dtsi"
#include "module/gps/mt6761-FLARE04-gps.dtsi"
#include "module/usb/usb_phy_tuning_FLARE04.dtsi"
#include "module/charger/mt6761-FLARE04-charger.dtsi"
#include "module/display/mt6761-FLARE00-display.dtsi"
#include "module/lights/mt6761-FLARE04-lights.dtsi"
#include "module/touchscreen/mt6761-FLARE04-touch.dtsi"
#include "module/battery/mt6761-FLARE04-batterydata.dtsi"
#include "module/pmic/mt6761-FLARE04-pmic.dtsi"
#include "module/audio/mt6761-FLARE04-buzzer.dtsi"
#include "module/audio/mt6761-FLARE04-audio.dtsi"