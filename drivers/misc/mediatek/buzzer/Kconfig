## drivers/misc/mediatek/buzzer/Kconfig
```kconfig
# This software is contributed or developed by KYOCERA Corporation.
# (C) 2022 KYOCERA Corporation
#
# Buzzer drivers configuration
#

config MTK_PWM_BUZZER
	tristate "Buzzer driver"
	default y
	  ---help---
	  Supports buzzer driver using MediaTek PWM.
	  If you want to use buzzer driver, say Y or M here.
	  If unsure, say N.
```

## drivers/misc/mediatek/sensors-1.0/alsps/stk3338_pm/Kconfig
```kconfig
#
# This software is contributed or developed by KYOCERA Corporation.
# (C) 2021 KYOCERA Corporation
#
comment "STK3338 Power Management Driver"

config STK3338_PM
	bool "STK3338 Power Mangement Driver"
	default n
```

## drivers/misc/mediatek/thermal/common/thermal_zones/Kconfig
```kconfig
menuconfig USB_THERMAL
	bool "Custom USB Thermal Configuration"
	default y
	depends on THERMAL
	help
	  This allows USB thermal.
	  If USB temperature is high, interrupt will trigger and system will report abnormal.
	  If you are not sure about this, set y
```

## drivers/misc/mediatek/video/mt6765/videox/kyocera/Kconfig
```kconfig
# This software is contributed or developed by KYOCERA Corporation.
# (C) 2022 KYOCERA Corporation
#

config DISP_EXT_SUB
	bool "To enable the sub display"
	default y
	---help---
	  Say Y here if you want to enable the sub display.
config DISP_EXT_I2C
	bool "To enable the i2c"
	default y
	---help---
	  Say Y here if you want to enable the i2c.
config DISP_EXT_SUB_ALWAYS_ON
	bool "To enable the always_on"
	default n
	---help---
	  Say Y here if you want to enable the always_on.
config DISP_EXT_SUB_CONTRAST
	bool "To enable the contrast"
	default n
	---help---
	  Say Y here if you want to enable the contrast.
config DISP_EXT_SUB_USER_CONTRAST
	bool "To enable the contrast"
	default n
	---help---
	  Say Y here if you want to enable the contrast.
config DISP_EXT_SPI
	bool "To enable the spi"
	default y
	---help---
	The MDSS debugging provides support to enable display debugging
	features to: Dump MDSS registers during driver errors, panic
	driver during fatal errors and enable some display-driver logging
	into an internal buffer (this avoids logging overhead).
```

## drivers/misc/swic/Kconfig
```kconfig
#
# This software is contributed or developed by KYOCERA Corporation.
# (C) 2022 KYOCERA Corporation
#

config KC_USB_SWIC
	tristate
	default y
```
